-- VHDL netlist generated by SCUBA ispLever_v70_SP1_Build (25)
-- Module  Version: 3.1
--C:\ispTOOLS7_0_STRT\ispfpga\bin\nt\scuba.exe -w -lang vhdl -synth synplify -bb -arch mg5g00 -type sdpram -rdata_width 9 -data_width 9 -num_rows 16 -outData UNREGISTERED -e 

-- Mon Feb 18 21:57:32 2008

library IEEE;
use IEEE.std_logic_1164.all;
-- synopsys translate_off
library xp;
use xp.components.all;
-- synopsys translate_on

entity clut is
    port (
        WrAddress: in  std_logic_vector(3 downto 0); 
        Data: in  std_logic_vector(8 downto 0); 
        WrClock: in  std_logic; 
        WE: in  std_logic; 
        WrClockEn: in  std_logic; 
        RdAddress: in  std_logic_vector(3 downto 0); 
        Q: out  std_logic_vector(8 downto 0));
end clut;

architecture Structure of clut is

    -- internal signal declarations
    signal scuba_vhi: std_logic;
    signal scuba_vlo: std_logic;
    signal dec_wre3: std_logic;

    -- local component declarations
    component DPR16X2B
        port (DI0: in  std_logic; DI1: in  std_logic; WCK: in  std_logic; 
            WRE: in  std_logic; RAD0: in  std_logic; RAD1: in  std_logic; 
            RAD2: in  std_logic; RAD3: in  std_logic; 
            WAD0: in  std_logic; WAD1: in  std_logic; 
            WAD2: in  std_logic; WAD3: in  std_logic; 
            WDO0: out  std_logic; WDO1: out  std_logic; 
            RDO0: out  std_logic; RDO1: out  std_logic);
    end component;
    component ROM16X1
    -- synopsys translate_off
        generic (initval : in String);
    -- synopsys translate_on
        port (AD3: in  std_logic; AD2: in  std_logic; AD1: in  std_logic; 
            AD0: in  std_logic; DO0: out  std_logic);
    end component;
    component VHI
        port (Z: out  std_logic);
    end component;
    component VLO
        port (Z: out  std_logic);
    end component;
    attribute initval : string; 
    attribute initval of LUT4_0 : label is "0x8000";

begin
    -- component instantiation statements
    scuba_vhi_inst: VHI
        port map (Z=>scuba_vhi);

    LUT4_0: ROM16X1
        -- synopsys translate_off
        generic map (initval=> "0x8000")
        -- synopsys translate_on
        port map (AD3=>WE, AD2=>WrClockEn, AD1=>scuba_vhi, 
            AD0=>scuba_vhi, DO0=>dec_wre3);

    scuba_vlo_inst: VLO
        port map (Z=>scuba_vlo);

    mem_0_0: DPR16X2B
        port map (DI0=>Data(8), DI1=>scuba_vlo, WCK=>WrClock, 
            WRE=>dec_wre3, RAD0=>RdAddress(0), RAD1=>RdAddress(1), 
            RAD2=>RdAddress(2), RAD3=>RdAddress(3), WAD0=>WrAddress(0), 
            WAD1=>WrAddress(1), WAD2=>WrAddress(2), WAD3=>WrAddress(3), 
            WDO0=>open, WDO1=>open, RDO0=>Q(8), RDO1=>open);

    mem_0_1: DPR16X2B
        port map (DI0=>Data(6), DI1=>Data(7), WCK=>WrClock, 
            WRE=>dec_wre3, RAD0=>RdAddress(0), RAD1=>RdAddress(1), 
            RAD2=>RdAddress(2), RAD3=>RdAddress(3), WAD0=>WrAddress(0), 
            WAD1=>WrAddress(1), WAD2=>WrAddress(2), WAD3=>WrAddress(3), 
            WDO0=>open, WDO1=>open, RDO0=>Q(6), RDO1=>Q(7));

    mem_0_2: DPR16X2B
        port map (DI0=>Data(4), DI1=>Data(5), WCK=>WrClock, 
            WRE=>dec_wre3, RAD0=>RdAddress(0), RAD1=>RdAddress(1), 
            RAD2=>RdAddress(2), RAD3=>RdAddress(3), WAD0=>WrAddress(0), 
            WAD1=>WrAddress(1), WAD2=>WrAddress(2), WAD3=>WrAddress(3), 
            WDO0=>open, WDO1=>open, RDO0=>Q(4), RDO1=>Q(5));

    mem_0_3: DPR16X2B
        port map (DI0=>Data(2), DI1=>Data(3), WCK=>WrClock, 
            WRE=>dec_wre3, RAD0=>RdAddress(0), RAD1=>RdAddress(1), 
            RAD2=>RdAddress(2), RAD3=>RdAddress(3), WAD0=>WrAddress(0), 
            WAD1=>WrAddress(1), WAD2=>WrAddress(2), WAD3=>WrAddress(3), 
            WDO0=>open, WDO1=>open, RDO0=>Q(2), RDO1=>Q(3));

    mem_0_4: DPR16X2B
        port map (DI0=>Data(0), DI1=>Data(1), WCK=>WrClock, 
            WRE=>dec_wre3, RAD0=>RdAddress(0), RAD1=>RdAddress(1), 
            RAD2=>RdAddress(2), RAD3=>RdAddress(3), WAD0=>WrAddress(0), 
            WAD1=>WrAddress(1), WAD2=>WrAddress(2), WAD3=>WrAddress(3), 
            WDO0=>open, WDO1=>open, RDO0=>Q(0), RDO1=>Q(1));

end Structure;

-- synopsys translate_off
library xp;
configuration Structure_CON of clut is
    for Structure
        for all:DPR16X2B use entity xp.DPR16X2B(V); end for;
        for all:ROM16X1 use entity xp.ROM16X1(V); end for;
        for all:VHI use entity xp.VHI(V); end for;
        for all:VLO use entity xp.VLO(V); end for;
    end for;
end Structure_CON;

-- synopsys translate_on
