-- VHDL netlist generated by SCUBA ispLever_v70_SP1_Build (25)
-- Module  Version: 3.6
--C:\ispTOOLS7_0_STRT\ispfpga\bin\nt\scuba.exe -w -n pll -lang vhdl -synth synplify -arch mg5g00 -type pll -fin 40 -fclkop 80 -fclkop_tol 0.0 -delay_cntl STATIC -fdel 0 -fb_mode CLOCKTREE -phaseadj 45 -duty 1 -fclkok 40 -fclkok_tol 0.0 -e 

-- Sun Oct 05 18:15:09 2008

library IEEE;
use IEEE.std_logic_1164.all;
-- synopsys translate_off
library xp;
use xp.components.all;
-- synopsys translate_on

entity pll is
    port (
        CLK: in std_logic; 
        RESET: in std_logic; 
        CLKOP: out std_logic; 
        CLKOS: out std_logic; 
        CLKOK: out std_logic; 
        LOCK: out std_logic);
 attribute dont_touch : string;
 attribute dont_touch of pll : entity is "true";
end pll;

architecture Structure of pll is

    -- internal signal declarations
    signal scuba_vlo: std_logic;
    signal CLKOP_t: std_logic;
    signal CLK_t: std_logic;

    -- local component declarations
    component EHXPLLB
    -- synopsys translate_off
        generic (DUTY : in String; PHASEADJ : in String; 
                DELAY_CNTL : in String; CLKOK_DIV : in String; 
                FDEL : in String; CLKFB_DIV : in String; 
                CLKOP_DIV : in String; CLKI_DIV : in String);
    -- synopsys translate_on
        port (RST: in std_logic; CLKI: in std_logic; CLKFB: in std_logic; 
            DDAMODE: in std_logic; DDAIZR: in std_logic; DDAILAG: in std_logic; 
            DDAIDEL0: in std_logic; DDAIDEL1: in std_logic; DDAIDEL2: in std_logic; 
            CLKOP: out std_logic; CLKOK: out std_logic; CLKOS: out std_logic; 
            LOCK: out std_logic; DDAOZR: out std_logic; DDAOLAG: out std_logic; 
            DDAODEL0: out std_logic; DDAODEL1: out std_logic; DDAODEL2: out std_logic);
    end component;
    component VLO
        port (Z: out std_logic);
    end component;
    attribute DELAY_CNTL : string; 
    attribute FDEL : string; 
    attribute DUTY : string; 
    attribute PHASEADJ : string; 
    attribute FB_MODE : string; 
    attribute FREQUENCY_PIN_CLKOS : string; 
    attribute FREQUENCY_PIN_CLKOP : string; 
    attribute FREQUENCY_PIN_CLKI : string; 
    attribute FREQUENCY_PIN_CLKOK : string; 
    attribute CLKOK_DIV : string; 
    attribute CLKOP_DIV : string; 
    attribute CLKFB_DIV : string; 
    attribute CLKI_DIV : string; 
    attribute FIN : string; 
    attribute DELAY_CNTL of PLLBInst_0 : label is "STATIC";
    attribute FDEL of PLLBInst_0 : label is "0";
    attribute DUTY of PLLBInst_0 : label is "2";
    attribute PHASEADJ of PLLBInst_0 : label is "135";
    attribute FB_MODE of PLLBInst_0 : label is "CLOCKTREE";
    attribute FREQUENCY_PIN_CLKOS of PLLBInst_0 : label is "80.000000";
    attribute FREQUENCY_PIN_CLKOP of PLLBInst_0 : label is "80.000000";
    attribute FREQUENCY_PIN_CLKI of PLLBInst_0 : label is "40.000000";
    attribute FREQUENCY_PIN_CLKOK of PLLBInst_0 : label is "40.000000";
    attribute CLKOK_DIV of PLLBInst_0 : label is "2";
    attribute CLKOP_DIV of PLLBInst_0 : label is "8";
    attribute CLKFB_DIV of PLLBInst_0 : label is "2";
    attribute CLKI_DIV of PLLBInst_0 : label is "1";
    attribute FIN of PLLBInst_0 : label is "40.000000";
    attribute syn_keep : boolean;
    attribute syn_noprune : boolean;
    attribute syn_noprune of Structure : architecture is true;

begin
    -- component instantiation statements
    scuba_vlo_inst: VLO
        port map (Z=>scuba_vlo);

    PLLBInst_0: EHXPLLB
        -- synopsys translate_off
        generic map (DELAY_CNTL=> "STATIC", FDEL=> "0", DUTY=> "2", 
        PHASEADJ=> "135", CLKOK_DIV=> "2", CLKOP_DIV=> "8", CLKFB_DIV=> "2", 
        CLKI_DIV=> "1")
        -- synopsys translate_on
        port map (RST=>RESET, CLKI=>CLK_t, CLKFB=>CLKOP_t, 
            DDAMODE=>scuba_vlo, DDAIZR=>scuba_vlo, DDAILAG=>scuba_vlo, 
            DDAIDEL0=>scuba_vlo, DDAIDEL1=>scuba_vlo, 
            DDAIDEL2=>scuba_vlo, CLKOP=>CLKOP_t, CLKOK=>CLKOK, 
            CLKOS=>CLKOS, LOCK=>LOCK, DDAOZR=>open, DDAOLAG=>open, 
            DDAODEL0=>open, DDAODEL1=>open, DDAODEL2=>open);

    CLKOP <= CLKOP_t;
    CLK_t <= CLK;
end Structure;

-- synopsys translate_off
library xp;
configuration Structure_CON of pll is
    for Structure
        for all:EHXPLLB use entity xp.EHXPLLB(V); end for;
        for all:VLO use entity xp.VLO(V); end for;
    end for;
end Structure_CON;

-- synopsys translate_on
